## Kconfig
```kconfig
#
# For a description of the syntax of this configuration file,
# see kconfig-language at https://www.kernel.org/doc/Documentation/kbuild/kconfig-language.txt
#

config LIB_CHROMIUM
  bool "The Chromium general utility library"
  default n
  select LIB_MODPB64
  ---help---
    The Chromium project has an general utility library referred to as libbase.
    Because it is standalone and does not depend on any other parts of Chromium,
    it has been been picked up by other Google related projects so people don't
    have to reinvent these things.

if LIB_CHROMIUM

config CHROMIUM_LOG_LEVEL
  int "Chromium Debug Log Level"
  default 3
  help
    Sets log level for the Chromium Base library.

endif
```
